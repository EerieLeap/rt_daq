## app/boards/nucleo_h753zi.conf
```kconfig
CONFIG_FLASH_SIZE=4096
# Use ADC simulator instead of real ADC
CONFIG_ADC=n

# CBF subsystem
CONFIG_CHARACTER_FRAMEBUFFER=y

# # ==============================
# # Instrumentation
# # ==============================
# CONFIG_TRACING=y
# CONFIG_INSTRUMENTATION=y
# CONFIG_INSTRUMENTATION_MODE_CALLGRAPH=y
```

## app/boards/qemu_cortex_a9.conf
```kconfig
# ==============================
# Peripherals
# ==============================
CONFIG_FLASH_SIMULATOR=y
CONFIG_ADC_EMUL=y
CONFIG_GPIO_EMUL=y

# ==============================
# FAT filesystem
# ==============================
CONFIG_FAT_FILESYSTEM_ELM=y
CONFIG_FS_FATFS_MKFS=y
CONFIG_FS_FATFS_MOUNT_MKFS=y
# FS Mutex
CONFIG_FS_FATFS_REENTRANT=y
CONFIG_FS_FATFS_LFN=y
CONFIG_FS_FATFS_LFN_MODE_HEAP=y

# ==============================
# Timing
# ==============================
CONFIG_TEST_RANDOM_GENERATOR=y

# ==============================
# CBF subsystem
# ==============================
CONFIG_CHARACTER_FRAMEBUFFER=y
```

## boards/eerieleap/esp32s3_pm_hw_02/Kconfig.esp32s3_pm_hw_02
```kconfig
# Copyright (c) 2025 Pavel Maloletkov
# SPDX-License-Identifier: Apache-2.0

config BOARD_ESP32S3_PM_HW_02
	select SOC_ESP32S3
	select SOC_ESP32S3_PROCPU if BOARD_ESP32S3_PM_HW_02_ESP32S3_PROCPU
	select SOC_ESP32S3_APPCPU if BOARD_ESP32S3_PM_HW_02_ESP32S3_APPCPU
```
