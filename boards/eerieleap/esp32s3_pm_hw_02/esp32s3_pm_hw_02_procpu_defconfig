## boards/eerieleap/esp32s3_pm_hw_02/esp32s3_pm_hw_02_procpu_defconfig
```kconfig
# SPDX-License-Identifier: Apache-2.0

CONFIG_CONSOLE=y
CONFIG_SERIAL=y
CONFIG_UART_CONSOLE=y
CONFIG_GPIO=y
CONFIG_CLOCK_CONTROL=y

CONFIG_SPI=y
CONFIG_SDHC=y
CONFIG_DISK_ACCESS=y
CONFIG_DISK_DRIVERS=y
CONFIG_DISK_DRIVER_SDMMC=y
CONFIG_I2C=y
CONFIG_DISPLAY=y
CONFIG_SSD1306=y
CONFIG_CAN_MCP251XFD=y
CONFIG_CAN_ESP32_TWAI=y
```

## west.yml
```yaml
# Copyright (c) 2021 Nordic Semiconductor ASA
# SPDX-License-Identifier: Apache-2.0

manifest:
  self:
    west-commands: scripts/west-commands.yml

  remotes:
    - name: zephyrproject-rtos
      url-base: https://github.com/zephyrproject-rtos

  projects:
    - name: zephyr
      remote: zephyrproject-rtos
      revision: main #NOTE: v4.1.0 doesn't support exteranl RAM for WiFi
      import:
        # By using name-allowlist we can clone only the modules that are
        # strictly needed by the application.
        name-allowlist:
          - cmsis           # required by the ARM port
          - cmsis_6         # required by the ARM port
          - mcuboot         # bootloader
          - esp32           # required by the esp32 board
          - hal_espressif   # required by the esp32 board
          - hal_st          # required by the stm board
          - hal_stm32       # required by the stm32 board
          - zcbor           # CBOR light JSON like data format
          - fatfs           # FATFS filesystem
          - littlefs        # littleFS lightweight filesystem
          - mbedtls         # esp32 WiFi
          - tf-psa-crypto   # required by mbedtls
          - picolibc        # picolibc
```
